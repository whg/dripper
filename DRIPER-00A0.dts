 // Compile with:
 // dtc -O dtb -I dts -o /lib/firmware/DRIPER-00A0.dtbo -b 0 -@ DRIPER-00A0.dts  
    
 /dts-v1/;  
 /plugin/;  
 
 / {  
   compatible = "ti,beaglebone", "ti,beaglebone-green", "ti,beaglebone-black";  
   part-number = "DRIPER";  
   version = "00A0";
   
   exclusive-use = "P8.39", "P8.40", "P8.41", "P8.42", "P8.43", "P8.44", "pru1";  
   
   fragment@0 {  
    target = <&am33xx_pinmux>;  
    __overlay__ {  
      pru_pins: pinmux_pru_pru_pins {  
       pinctrl-single,pins = <  
	 0xb8 0x05 // P8_39 r30_6
	 0xbc 0x05 // P8_40 r30_7
	 0xb0 0x05 // P8_41 r30_4
	 0xb4 0x05 // P8_42 r30_5
	 0xa8 0x05 // P8_43 r30_2
	 0xac 0x05 // P8_44 r30_3
       >;  
      };  
    };  
   };  
   
   fragment@1 {  
    target = <&pruss>;  
    __overlay__ {  
      status = "okay";  
      pinctrl-names = "default";  
      pinctrl-0 = <&pru_pins>;  
    };  
   };  
 };  
  